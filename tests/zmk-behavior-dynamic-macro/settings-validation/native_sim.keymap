/*
 * Copyright (c) 2026 The ZMK Behavior Dynamic Macro Contributors
 *
 * SPDX-License-Identifier: MIT
 */

#include <dt-bindings/zmk/keys.h>
#include <behaviors.dtsi>
#include <behaviors/zbdm.dtsi>
#include <dt-bindings/zmk/kscan_mock.h>

/ {
    keymap {
        compatible = "zmk,keymap";

        default_layer {
            bindings = <&kp A>;
        };
    };
};

&kscan {
    rows = <1>;
    columns = <1>;
    events = <ZMK_MOCK_PRESS(0,0,10) ZMK_MOCK_RELEASE(0,0,20)>;
};
