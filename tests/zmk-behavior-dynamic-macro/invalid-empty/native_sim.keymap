/*
 * Copyright (c) 2026 The ZMK Behavior Dynamic Macro Contributors
 *
 * SPDX-License-Identifier: MIT
 */

#include <dt-bindings/zmk/keys.h>
#include <behaviors.dtsi>
#include <behaviors/zbdm.dtsi>
#include <dt-bindings/zmk/kscan_mock.h>
#include <dt-bindings/zmk/zbdm.h>

/ {
    keymap {
        compatible = "zmk,keymap";

        default_layer {
            bindings = <&zbdm ZBDM_PLAY 1 &zbdm ZBDM_PLAY 2 &zbdm ZBDM_CLEAR 2 &kp A>;
        };
    };
};

&kscan {
    rows = <1>;
    columns = <4>;
    events = <
        ZMK_MOCK_PRESS(0,0,10) ZMK_MOCK_RELEASE(0,0,20)
        ZMK_MOCK_PRESS(0,1,30) ZMK_MOCK_RELEASE(0,1,40)
        ZMK_MOCK_PRESS(0,2,50) ZMK_MOCK_RELEASE(0,2,60)
        ZMK_MOCK_PRESS(0,3,70) ZMK_MOCK_RELEASE(0,3,80)
    >;
};
